## linux-3.14/drivers/virt/Kconfig
```kconfig
#
# Virtualization support drivers
#
menuconfig VIRT_DRIVERS
	bool "Virtualization drivers"
	---help---
	  Say Y here to get to see options for device drivers that support
	  virtualization environments.

	  If you say N, all options in this submenu will be skipped and disabled.

if VIRT_DRIVERS

# Virtual drivers specific configuration
config L2LV
	bool "Enable OpenSynergy L2LV framework drivers"
	default n
	help
	  With this option, L2L drivers become available. These are
	  device drivers which are shared between linux partitions.
	  Each driver has a server and a client configuration option -
	  server should be enabled on a direct-io linux only. If
	  client option is enabled, a proxy device driver is enabled
	  that uses the respective server via hypervisor inter-partition
	  communication.

	  Note: using these features also requires proper hypervisor
	  configuration. TODO: link to detailed configuration documentation.

	  If unsure, say N.

if L2LV
	source "drivers/virt/l2lv/Kconfig"
endif

config FSL_HV_MANAGER
	tristate "Freescale hypervisor management driver"
	depends on FSL_SOC
	select EPAPR_PARAVIRT
	help
          The Freescale hypervisor management driver provides several services
	  to drivers and applications related to the Freescale hypervisor:

          1) An ioctl interface for querying and managing partitions.

          2) A file interface to reading incoming doorbells.

          3) An interrupt handler for shutting down the partition upon
	     receiving the shutdown doorbell from a manager partition.

          4) A kernel interface for receiving callbacks when a managed
	     partition shuts down.

endif
```

## linux-3.14/drivers/virt/l2lv/Kconfig
```kconfig
menu "Linux-2-linux virtualization"


# Virtual drivers specific configuration

choice
	prompt "L2LV Role"
	default L2LV_CLIENT
	depends on L2LV
	---help---
	  Selects, whether the shared driver implements the client or the
	  server interface.

config L2LV_CLIENT
	bool "L2LV Client"
	depends on L2LV
	---help---
	  Use a shared driver from another partition.

config L2LV_SERVER
	bool "L2LV Server"
	depends on L2LV
	---help---
	  Provide a shared driver that is used by other partitions.

endchoice

config L2LV_TEST
	bool "l2lv_test"
	---help---
	  Enables test message for testing the l2lv.

config L2LV_DEBUG
	bool "l2lv_debug"
	---help---
	  Enables debug messages in the l2lv code.

config L2LV_TEST_DRV
	bool "l2lv_test_drv"
	depends on L2LV
	---help---
	  Enables the l2lv test drivers.

config L2LV_TEST_SERVER
	bool "test_server"
	depends on L2LV_SERVER && L2LV_TEST_DRV
	---help---
	  Provide a server for l2lv test device.

config L2LV_TEST_CLIENT
	bool "test_client"
	depends on L2LV_CLIENT && L2LV_TEST_DRV
	---help---
	  Provide a client for l2lv test device.

config L2LV_VBD
	tristate "Enable virtual block device (client)"
	default n
	depends on L2LV_CLIENT
	---help---
	  WARNING: This driver is not yet fully functional

	  This is a L2LV virtual block device. It needs proper configuration
	  and a corresponding L2LV block device server.

	  To compile this driver as a module, choose M here: the
	  module will be called vbd.

	  If unsure, say N.

config L2LV_VBD_SERVER
        tristate "Enable virtual block device (server)"
        default n
        depends on L2LV_SERVER
        ---help---
          WARNING: This driver is not yet fully functional

          This is a L2LV virtual block device. It needs proper configuration
          and a corresponding L2LV block device server.

          To compile this driver as a module, choose M here: the
          module will be called vbd.

          If unsure, say N.

endmenu
```

## linux-3.14/fs/pikeosfs/Kconfig
```kconfig
config PIKEOSFS
	tristate "PikeOS FS (EXPERIMENTAL)"
	depends on P4
	help
	  pikeosfs allows to access PikeOS Volume Providers within Linux
```
